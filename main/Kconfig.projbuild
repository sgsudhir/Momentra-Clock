## main/Kconfig.projbuild
```kconfig
menu "P10 clock hardware"

    config CLOCK_PANEL_ENABLED
        bool "Enable experimental 32x16 1/4-scan HUB12 panel driver"
        default n
        help
            Enable only after confirming the panel scan, polarity and wiring.
            The row/shift order may not match every HUB12 panel.

    config CLOCK_OE_ACTIVE_LOW
        bool "Output enable is active low"
        default n
        help
            DMD2-compatible panels use an active-high enable. Enable this
            option only if the physical panel requires an active-low enable.

    config CLOCK_DATA_ACTIVE_LOW
        bool "Panel data is active low"
        default y

    config CLOCK_PIN_DATA
        int "Panel DATA GPIO (-1 means unconfigured)"
        range -1 48 if IDF_TARGET_ESP32S3
        range -1 33 if !IDF_TARGET_ESP32S3
        default -1

    config CLOCK_PIN_CLOCK
        int "Panel CLOCK GPIO (-1 means unconfigured)"
        range -1 48 if IDF_TARGET_ESP32S3
        range -1 33 if !IDF_TARGET_ESP32S3
        default -1

    config CLOCK_PIN_LATCH
        int "Panel LATCH GPIO (-1 means unconfigured)"
        range -1 48 if IDF_TARGET_ESP32S3
        range -1 33 if !IDF_TARGET_ESP32S3
        default -1

    config CLOCK_PIN_OE
        int "Panel output-enable GPIO (-1 means unconfigured)"
        range -1 48 if IDF_TARGET_ESP32S3
        range -1 33 if !IDF_TARGET_ESP32S3
        default -1

    config CLOCK_PIN_A
        int "Panel row A GPIO (-1 means unconfigured)"
        range -1 48 if IDF_TARGET_ESP32S3
        range -1 33 if !IDF_TARGET_ESP32S3
        default -1

    config CLOCK_PIN_B
        int "Panel row B GPIO (-1 means unconfigured)"
        range -1 48 if IDF_TARGET_ESP32S3
        range -1 33 if !IDF_TARGET_ESP32S3
        default -1

    config CLOCK_PIN_BUZZER
        int "Active buzzer GPIO (-1 means unconfigured)"
        range -1 48 if IDF_TARGET_ESP32S3
        range -1 33 if !IDF_TARGET_ESP32S3
        default -1

endmenu
```

## sdkconfig.defaults
```kconfig
CONFIG_PARTITION_TABLE_CUSTOM=y
CONFIG_PARTITION_TABLE_CUSTOM_FILENAME="partitions.csv"
CONFIG_BOOTLOADER_APP_ROLLBACK_ENABLE=y
CONFIG_FREERTOS_HZ=1000
CONFIG_LWIP_TCPIP_TASK_AFFINITY_CPU0=y
CONFIG_ESPTOOLPY_FLASHSIZE_4MB=y
CONFIG_CLOCK_PANEL_ENABLED=y
# CONFIG_CLOCK_OE_ACTIVE_LOW is not set
CONFIG_CLOCK_PIN_DATA=23
CONFIG_CLOCK_PIN_CLOCK=18
CONFIG_CLOCK_PIN_LATCH=19
CONFIG_CLOCK_PIN_OE=21
CONFIG_CLOCK_PIN_A=22
CONFIG_CLOCK_PIN_B=25
CONFIG_CLOCK_PIN_BUZZER=26
```
